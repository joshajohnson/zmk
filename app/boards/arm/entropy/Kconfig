## app/boards/arm/entropy/Kconfig
```kconfig
# Copyright (c) 2021 Josh Johnson
# SPDX-License-Identifier: MIT

config BOARD_ENABLE_DCDC
	bool "Enable DCDC mode"
	select SOC_DCDC_NRF52X
	default n
	depends on BOARD_ENTROPY
```

## app/boards/arm/entropy/Kconfig.board
```kconfig
# Copyright (c) 2021 Josh Johnson
# SPDX-License-Identifier: MIT

config BOARD_ENTROPY
	bool "Entropy"
	depends on SOC_NRF52840_QIAA
```

## app/boards/arm/entropy/Kconfig.defconfig
```kconfig
# Copyright (c) 2021 Josh Johnson
# SPDX-License-Identifier: MIT

if BOARD_ENTROPY

config ZMK_KEYBOARD_NAME
	default "Entropy"

if USB

config USB_NRFX
	default y

config USB_DEVICE_STACK
	default y

endif # USB

config BT_CTLR
	default BT

config ZMK_BLE
	default y

config ZMK_USB
	default y

config ZMK_BATTERY_VOLTAGE_DIVIDER
	default y

endif # BOARD_ENTROPY
```
